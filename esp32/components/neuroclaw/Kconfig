## esp32/components/neuroclaw/Kconfig
```kconfig
menu "NeuroClaw-ESP"

    config NEUROCLAW_TASK_STACK
        int "Brain task stack (bytes)"
        default 8192
        range 6144 32768

    config NEUROCLAW_HISTORY
        int "Messages kept after the system prompt"
        default 16
        range 4 64
        help
            The conversation is saved to sessions/telegram.json of the
            workspace after every turn and read back at boot.

    config NEUROCLAW_MAX_ROUNDS
        int "LLM rounds per owner message"
        default 4
        range 1 8
        help
            A round is one LLM call; tool calls start another. After this many
            the owner is told the request was not finished.

    config NEUROCLAW_HEARTBEAT_MIN
        int "Heartbeat interval (minutes, 0 = off)"
        default 30
        range 0 1440
        help
            As the Go NeuroClaw's heartbeat (default 30): every so often the
            brain reads HEARTBEAT.md of its workspace and, if it lists tasks,
            checks them; a reply of HEARTBEAT_OK is not sent to the owner.

    config NEUROCLAW_SEND_FILE_MAX
        int "Largest file send_file sends (bytes)"
        default 10485760
        range 1024 52428800
        help
            The file is streamed from flash to Telegram, so this is not bounded
            by RAM; Telegram takes documents up to 50 MB, photos up to 10 MB.

    config NEUROCLAW_POLL_S
        int "Telegram long-poll timeout (s)"
        default 25
        range 1 50

    config NEUROCLAW_HTTP_MAX
        int "Largest HTTP reply kept (bytes)"
        default 65536
        range 8192 524288
        help
            A larger reply is dropped, never cut: a cut JSON reply could parse
            into something the model did not say.

endmenu
```

## esp32/examples/qemu/main/Kconfig.projbuild
```kconfig
menu "NeuroClaw-ESP QEMU example"
    config EXAMPLE_CLOUD
        string "Fake Telegram + LLM on the host"
        default "http://10.0.2.2:8090"
    config EXAMPLE_OWNER
        string "Owner's Telegram user id"
        default "123456789"
endmenu
```

## esp32/examples/wifi/main/Kconfig.projbuild
```kconfig
menu "NeuroClaw-ESP Wi-Fi example"
    config EXAMPLE_WIFI_SSID
        string "Wi-Fi SSID"
    config EXAMPLE_WIFI_PASSWORD
        string "Wi-Fi password"
    config EXAMPLE_TELEGRAM_TOKEN
        string "Telegram bot token"
    config EXAMPLE_OWNER
        string "Owner's Telegram user id"
    config EXAMPLE_LLM_API
        string "LLM format: openai or anthropic"
        default "openai"
    config EXAMPLE_LLM_URL
        string "LLM URL (chat completions, or Messages for anthropic)"
        default "https://api.openai.com/v1/chat/completions"
    config EXAMPLE_LLM_KEY
        string "LLM API key"
    config EXAMPLE_LLM_MODEL
        string "LLM model"
        default "gpt-4.1-mini"
    config EXAMPLE_TAVILY_KEY
        string "Tavily API key (empty: no web_search)"
endmenu
```

## esp32/examples/wifi/sdkconfig.defaults
```kconfig
CONFIG_ESPTOOLPY_FLASHSIZE_4MB=y
CONFIG_PARTITION_TABLE_CUSTOM=y
CONFIG_PARTITION_TABLE_CUSTOM_FILENAME="partitions.csv"
CONFIG_ESP_HTTP_CLIENT_ENABLE_HTTPS=y
```
